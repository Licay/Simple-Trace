## Kconfig
```kconfig
# SPDX-License-Identifier: GPL-2.0

config SIMPLE_TRACE
	tristate "simple trace support"
	depends on KPROBES
	default n
	help
	  If you say Y here, the support for simple_trace

config SIMPLE_TRACE_LOGSIZE_SHIFT
	int "simple trace log size shift"
	range 8 20
	depends on SIMPLE_TRACE
	default 12
	help
		log_size = (1 << SIMPLE_TRACE_LOGSIZE_SHIFT)

config SIMPLE_LOOKUP_NAME
	tristate "simple lookup name support"
	depends on KPROBES
	default n
	help
	  If you say Y here, the support for simple_lookup_name

config SIMPLE_LOOKUP_NAME_PROC
	bool "simple lookup name proc support"
	depends on SIMPLE_LOOKUP_NAME
	default n
	help
	  If you say Y here, the support for simple_lookup_name_proc
	  will be enabled. This will create a /proc entry for the
	  simple_lookup_name.
```
